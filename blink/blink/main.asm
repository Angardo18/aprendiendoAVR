;
; blink.asm
;
; Created: 2/12/2020 16:07:29
; Author : Angel Orellana
; PROGRAMA INICIAL HACE TITILAR UN LED

;CONFIGURACION
.INCLUDE "TN85DEF.INC" ; TNXXXDEF.IN PARA LAS DEFINICIONES MXXXDEF.INC PARA ATMEGA  

.CSEG	;GRABADO EN LA MEMORIA FLASH

;0X60 .EQU DELAY
.SET DELAY1 = 0x61 ;VARIABLE
.ORG 0 ;COMIENZA A ESCRIBIR EN 0 DESDE LA MEMORIA DE PROGRAMA
; PUNTERO DE STACK 
LDI	R16, LOW(RAMEND)
OUT SPL, R16
SBI DDRB, 1 ;BIT 0 EN 1
INICIO:
; Replace with your application code
;CLR	DDRB ;SE LIMPIA EL REGISTRO
	
	SBI	PORTB, 1 ;SE COLOCA EN 1 EL PORTB0 
	RCALL DELAYLONG
	CBI	PORTB, 1 ;SE COLOCA EN 1
	RCALL DELAYLONG 
	RJMP INICIO ; SE VA A INICIO

DELAYLONG:
	CLR R18 ;SE COLOCA EN CERO
	COMPARACION3:
	CPI R18, 2
	BREQ SALIR  
	RCALL	DELAYMED
	INC R18
	RJMP COMPARACION3
	SALIR:
	RET

DELAYMED:
	CLR R17 ;SE COLOCA EN CERO
	COMPARACION2:
	CPI R17, 255
	BREQ SAL  
	RCALL	DELAY
	INC R17
	RJMP COMPARACION2
	SAL:
	RET

DELAY:
	CLR	R16 ;SE COLOCA EN 0
	COMPARACION:
	CPI R16, 255 ;SE COMPARA SI ES 255
	BREQ DEVUELTA ;SI SON IGUALES SE HACE UN SALTO DE  INSTRUCCIONES
	INC	R16 ;SE INCREMENTA
	RJMP COMPARACION
	DEVUELTA:
	RET
	
	
	