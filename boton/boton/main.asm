;
; boton.asm
;
; Created: 3/12/2020 11:58:31
; Author : Angel Orellana
;APRENDIENDO A LEER ENTRADAS DIGITALES
.SET	PORTB_ANTERIOR = 0x61
.SET	PORTB_ACTUAL = 0x62

.ORG 0x0000  ;YA QUE NO SE USAN INTERRUPCIONES
CONFIGURACION:
	LDI R16, 0b0000_0010 ;B1 COMO SALIDA LAS DEMAS COMO ENTRADAS
	OUT	DDRB, R16 ;SE CARGA LA CONFIGURACION AL REGISTRO DDR
	SBI	PORTB, 1 ;RB1 EN 1 LOGICO AL INICIAR
	SBI	PORTB, 0 ;DD0 0 Y PB0 1, SE ACTIVA LA PULL UP
	;CBI	MCUCR, 6
	IN	R16, MCUCR
	CBR	R16, 6
	OUT	MCUCR, R16 ;SE HABILITA EL PULL UP INTERNO
LOOP:
	LDS R17, PORTB_ACTUAL
	STS	PORTB_ANTERIOR, R17 ;EL VALOR ANTERIOR SE VUELVE EL ACTUAL
	RCALL DELAY
	IN	R16, PINB 
	STS	PORTB_ACTUAL, R16
	
	LDS	R17, PORTB_ANTERIOR
	LDS	R16, PORTB_ACTUAL 
	;AQUI SE VERIFICA SI HUBO UN FLANCO DE SUBIDA, EN R17 ESTA EL VALOR ANTERIOR Y EN R16 ESTA EL VALOR ACTUAL
	SBRC R17,0 ;SI ESTA EN CERO EL ANTERIOR ES QUE SE PRESIONO
	RJMP LOOP
	SBRS R16, 0;SI ESTA EN 1 SE LO SALTA
	RJMP LOOP
	
	SBI PINB, 1 ;TOGGLE RB1 
	;IN	R16, PORTB
	;SBRS	R16, 1
	;RJMP	ES_0

	;CBI	PORTB, 1
	;RJMP	LOOP

	;ES_0:
	;SBI PORTB,1
	RJMP LOOP

DELAY:
	LDI R18, 0
	COMPARACION:
	CPI	R18,100
	BREQ SALIR
	INC R18
	RJMP COMPARACION
	SALIR:
	RET



; Replace with your application code
