;
; reloj.asm
;
; Created: 7/12/2020 14:49:34
; Author : Angel Orellana
;
.INCLUDE "TN85DEF.INC"
.INCLUDE "TM1637.INC"
;------ CONSTANTES USADAS PARA LA LIBRERIA TM1637
.EQU TMPORT = PORTB
.EQU TMDDR = DDRB
.EQU TMDATA = 1
.EQU TMCLK = 0 
.EQU VAL_TMR0 = 98;0x0B

.DSEG
; Replace with your application code
;------------- USADOS PARA DETERMINAR LOS VALORES DE LOS DIGITOS --------
CONT_L: .BYTE 1
CONT_LM: .BYTE 1
CONT_HM: .BYTE 1
CONT_H: .BYTE 1
;--------- VARIABLES PARA GUARDAR ENTORNO ---------
STATUS_RAM: .BYTE 1

.CSEG 
.ORG 0x0000
	RJMP CONFIGURACION
.ORG 0x0005
	RJMP ISR_TMR0
TABLE:.DB  0x3f,0x06,0x5b,0x4f,0x66,0x6d,0x7d,0x07,0x7f,0x6f,0x00
CONFIGURACION:
	;----- CONFIGURACION DEL TMR0 ----------------
	;IN R16, GTCCR
	;SBR	R16, 
	CLR R16
	OUT TCCR0A, R16 ;COMPARE MATCH A Y B DESCONECTADO MODO DE OPERACION NORMAL

	SBR	R16, 5; PRESCALER DE 1:1024
	OUT TCCR0B, R16; SE CARGA EL VALOR

	LDI	R16, VAL_TMR0 
	OUT TCNT0, R16; SE CARGA EL VALOR PARA QUE LA  INTERRUPCION SUCEDA A LOS 250 MS APROX

	;----- INTERRUPCIONES ---------------------
	CLR R16;0
	SBR	R16, 2; SE COLOCA EN 1 EL BIT 1
	OUT TIMSK, R16; SE CONFIGURA LA INTERRUPCION
	SEI ;SE ACTIVAN LAS INTRRUPCIONES
	;--------- INICIALIZACION DE CONTADORES -------------
	CLR R16
	STS	CONT_L, R16
	STS CONT_LM, R16
	STS CONT_HM, R16
	STS CONT_H, R16

	RCALL TM_INITIAL
LOOP:
	LDS	R16, CONT_L
	STS	VAL1, R16
	

;-------- CORRECCION EN BCD -------------------------------------------
CORREGIR_BCD:
	LDS	R16, CONT_L
	CPI R16, 10; SE COMPARA CON 10
	BREQ INCREMENTAR_LM ;SI ES 
	RET
	INCREMENTAR_LM:
	CLR	R16
	STS CONT_L, R16
	LDS	R16, CONT_LM
	INC R16
	CPI R16, 10
	BREQ INCREMENTAR_HM
	;- ELSE
	STS  CONT_LM,R16
	RET
	INCREMENTAR_HM:
	CLR R16
	STS CONT_LM, R16 ;SE COLOCA EN 0
	LDS	R16, CONT_HM
	INC	R16
	CPI R16, 10
	BREQ INCREMENTAR_H
	;-- SI NO -----
	STS CONT_HM, R16
	RET
	INCREMENTAR_H:
	CLR R16
	STS CONT_HM, R16
	LDS	R16, CONT_H
	INC R16
	CPI R16, 10
	BREQ FIN
	;-- SI NO ES IGUAL---
	STS	CONT_H, R16
	RET
	FIN:
	CLR R16
	STS CONT_H,R16
	RET ;FIN DE TODO


ISR_TMR0:
	IN	R18, SREG
	STS	STATUS_RAM, R18

	LDS	R18, CONT_L
	INC	R18
	STS	CONT_L, R18

	LDI	R18, VAL_TMR0
	OUT TCNT0, R18

	LDS R18, STATUS_RAM
	OUT SREG, R18
	RETI
