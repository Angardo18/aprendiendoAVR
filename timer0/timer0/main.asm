;
; timer0.asm
;
; Created: 4/12/2020 11:13:40
; Author : Angel Orellana
; SE USA EL TIMER 0 PARA INCREMENTAR EL VALOR DEL PUERTO B

.EQU VALOR_TMR0 = 11 ;VALOR QUE SERA CARGADO EN EL TIMER0

.DSEG
CONTADOR: .BYTE 1 
STATUS_RAM: .BYTE 1

.CSEG
.ORG 0x0000
	RJMP CONFIGURACION
.ORG 0x0005 ;INTERRUPCION DE OVERFLOW 
	RJMP ISR_TMR0_OVERFLOW
CONFIGURACION:
	;AQUI SE CONFIGURAN TODO 
	;------------ PUERTO B -----------------------------------
	SER R16 ;TODO COLOCADO A FF
	OUT DDRB,R16 ;TODOS LOS PINES COMO SALIDA
	CLR	R16 
	OUT PORTB,R16 ;TODO EN 0 INICIALMENTE
	;------- TMR 0 -------------------------------------------
	IN	R16, GTCCR ;SE MUEVE PARA PODER CAMBIAR LOS BITS
	CBR	R16, 7 ;SE LIMPIA EL TSM PARA EVITAR UN REINICIO DEL PRESCALER
	OUT	GTCCR, R16 ;SE GUARDA CON EL BIT MODIFICADO
	CLR	R16 ;SE COLOCA EN 0 EL REGISTO
	OUT	TCCR0A,R16 ;MODO NORMAL EN COMPARACION CON A Y B, ADEMAS DE MODO NORMAL EN WAVE FORM GENERATION
	
	SBR	R16, 5; BIT 0 Y 2 ENCENDIDOS EL RESTO APAGADOS 
	;SBR	R16,0 ;PRESCALER 1:1024
	OUT TCCR0B, R16 ; SE CONFIGURA
	LDI	R16, VALOR_TMR0 
	OUT	TCNT0, R16 ;SE TARDARA APROXIMADAMENTE 250 MS EN GENERAR UNA INTERRUPCION 
	;---------------- INTERRUPCIONES --------------------------
	CLR	R16 ;SE LIMPIA EL REGISTRO
	SBR R16,1 <<TOIE0 ;SE HABILITA LA INTERRUPCION
	OUT	TIMSK , R16 ;SE CARGA LAS CONFIGURACIONES 
	;----------------------------------------------------------
	SEI ;HABILITA LAS INTERRUPCIONES
	;------------ INICIALIZACION DE LAS VARIABLES -------------
	CLR	R16
	STS	CONTADOR, R16 ;SE COLOCA EN 0 
LOOP:
	LDS	R16, CONTADOR
	CPI	R16, 5 ;SE COMPARA CON 5
	BREQ INCREMENTO
	RJMP LOOP

	INCREMENTO:
	CLR	R16
	STS	CONTADOR, R16
	IN	R16, PORTB
	INC	R16
	OUT PORTB, R16
	CPI R16, 32
	BRNE LOOP ;SI NO ES IGUAL SE VA AL LOOP DE LO CONTRARIO SE LIMPIA EL PUERTO

	CLR	R16
	OUT PORTB, R16
	RJMP LOOP

ISR_TMR0_OVERFLOW:
	IN	R17, SREG
	STS	STATUS_RAM, R17 ;SE GUARDA EL VALOR DE STATUS ANTES DE TODO

	LDI	R17, VALOR_TMR0
	STS	TCNT0, R17 ;COMIENZA LA CUENTA DE NUEVO

	LDS	R17, CONTADOR
	INC R17
	STS CONTADOR, R17; SE INCREMENTA EL CONTADOR 

	LDS	R17, STATUS_RAM
	OUT	SREG, R17 ;SE DEVUELVE STATUS A SU VALOR ANTERIOR
	RETI ;FIN DE LA INTERRUPCION 

; Replace with your application code

